## boards/shields/scyan_screen/Kconfig.shield
```kconfig
# Copyright (c) 2026 Scyan ZMK Studio
# SPDX-License-Identifier: MIT

config SHIELD_SCYAN_SCREEN
    def_bool $(shields_list_contains,scyan_screen)

config SHIELD_SCYAN_SCREEN_1
    def_bool $(shields_list_contains,scyan_screen_1)

config SHIELD_SCYAN_SCREEN_2
    def_bool $(shields_list_contains,scyan_screen_2)
```

## config/west.yml
```yaml
manifest:
  remotes:
    - name: zmkfirmware
      url-base: https://github.com/zmkfirmware
    - name: brunowb
      url-base: https://github.com/BrunoWB
    # Additional modules containing boards/shields/custom code can be listed here as well
    # See https://docs.zephyrproject.org/3.2.0/develop/west/manifest.html#projects
  projects:
    - name: zmk
      remote: zmkfirmware
      revision: main
      import: app/west.yml
    - name: nv-gem
      url: https://github.com/olliehunter/zmk-module
      revision: nv_gem
    - name: scyan-zmk-module
      remote: brunowb
      revision: main
  self:
    path: config
```
